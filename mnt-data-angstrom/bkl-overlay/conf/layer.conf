## mnt-data-angstrom/bkl-overlay/conf/layer.conf
```bitbake
BBFILES += "${LAYERDIR}/recipes/*/*.bb"
BBPATH .= ":${LAYERDIR}"
BBFILE_COLLECTIONS += "bkl"
BBFILE_PRIORITY_bkl = "2"
BBFILE_PATTERN_bkl = "^${LAYERDIR}/"
```

## mnt-data-angstrom/build/conf/bblayers.conf
```bitbake
# LAYER_CONF_VERSION is increased each time build/conf/bblayers.conf
# changes incompatibly
LCONF_VERSION = "1"

BBFILES ?= ""

# Add your overlay location to BBLAYERS
# Make sure to have a conf/layers.conf in there
BBLAYERS = " \
  /mnt/data/angstrom/sources/openembedded \
  /mnt/data/angstrom/bkl-overlay \
  "
```

## mnt-data-angstrom/build/conf/local.conf
```bitbake
# Where to store sources
DL_DIR = "/mnt/data/angstrom/oe-downloads/"


ANGSTROM_QT_VERSION = "4.7.1"

INHERIT += "rm_work"

# Which files do we want to parse:
#BBFILES ?= "/mnt/data/angstrom/sources/openembedded/recipes/*/*.bb"
BBMASK = ""

# Qemu 0.12.x is giving too much problems recently (2010.05), so disable it for users
ENABLE_BINARY_LOCALE_GENERATION = "0"

# What kind of images do we want?
IMAGE_FSTYPES += "tar.bz2"

# Make use of SMP:
#   PARALLEL_MAKE specifies how many concurrent compiler threads are spawned per bitbake process
#   BB_NUMBER_THREADS specifies how many concurrent bitbake tasks will be run
#PARALLEL_MAKE     = "-j2"
BB_NUMBER_THREADS = "2"

DISTRO   = "angstrom-2008.1"
MACHINE ?= "beagleboard"


# Set TMPDIR instead of defaulting it to /tmp
TMPDIR = "/mnt/data/angstrom/build/tmp-angstrom_2008_1"

# Don't generate the mirror tarball for SCM repos, the snapshot is enough
BB_GENERATE_MIRROR_TARBALLS = "0"

# Go through the Firewall
#HTTP_PROXY        = "http://:/"
```
